/*
 * Copyright (C) 2013 CircuitCo
 *
 * Virtual cape for UART1 on connector pins P9.24 P9.26
 *
 * This program is free software; you can redistribute it and/or modify
 * it under the terms of the GNU General Public License version 2 as
 * published by the Free Software Foundation.
 */
/dts-v1/;
/plugin/;

/ {
   	compatible = "ti,beaglebone", "ti,beaglebone-black";

        /* identification */
        part-number = "BB-EHRPWM0A";
        version = "00A0";

        /* state the resources this cape uses */
        exclusive-use =
                /* the pin header uses */
                "P9.22",        /* EHRPWM0A */
                /* the hardware ip uses */
                "ehrpwm0A";

        fragment@0 {
                target = <&am33xx_pinmux>;
                __overlay__ {
                        bb_ehrpwm0a_pins: pinmux_bb_ehrpwm0a_pins {
                                pinctrl-single,pins = <
                                        0x150 0x33 /* P9.22 ehrpwm0A, PULLDOWN | MODE 3 */
                                        
                                >;
                        };
                };
        };

	fragment@1 {
                target = <&ehrpwm0a>;	/* really ehrpwm0a */
                __overlay__ {
                        status = "okay";
                        pinctrl-names = "default";
                        pinctrl-0 = <&bb_ehrpwm0a_pins>;
                };
        };
};